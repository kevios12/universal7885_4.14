// / {
	exynos-pm-extra{
		compatible = "samsung,exynos-pm-extra";
		// From 4.14
		wakeup_stat = <0x600 0x604>;

		wakeup_stats {
			wakeup_stat {
				// Not in 4.14
				/*
				addr = <0x0600>;
				bits_to_check = "0-30";*/
				ws-name = "EINT", "RTC_ALARM", "RTC_TICK", "TRTC_ALARM",
					 "TRTC_TICK", "PCIE_WIFI0", "PCIE_WIFI1", "EXT_PCIE_WIFI0",
					 "EXT_PCIE_WIFI1", "MMC0", "MMC1", "MMC2",
					 "DECON", "I2S", "TIMER", "USB_REWA",
					 "CP_SCAN_DUMP_REQ", "NFC_CLK_REQ", "USB20_PHY", "WIFI_ACTIVE",
					 "CP_RESET_REQ", "GNSS_WAKEUP_REQ", "GNSS_RESET_REQ", "GNSS_ACTIVE",
					 "INT_MBOX_CP", "CP_ACTIVE", "INT_MBOX_GNSS", "INT_MBOX_WIFI_CM4",
					 "CORTEXM0_APM", "WIFI_RESET_REQ", "Reserved";

				// Not in 4.14
				//eint_wakeup_check_bit = <0>;
			};

			wakeup2_stat {
				// Not in 4.14
				/*
				addr = <0x0604>;
				bits_to_check = "8-10";*/
				//Only last 3 in 4.4
				ws-name = "EXT_GIC_CLUSTER0_IRQOUT0", "EXT_GIC_CLUSTER0_FIQOUT0",
					"EXT_GIC_CLUSTER0_IRQOUT1", "EXT_GIC_CLUSTER0_FIQOUT1",
					"EXT_GIC_CLUSTER2_IRQOUT0", "EXT_GIC_CLUSTER2_FIQOUT0",
					"EXT_GIC_CLUSTER2_IRQOUT1", "EXT_GIC_CLUSTER2_FIQOUT1",
					"INT_MBOX_CP_SECURE", "INT_MBOX_IN_APM", "INT_MBOX_WIFI_CR4";
			};
		};
	};
// };
